## agent/esp32/malgrind/Kconfig.projbuild
```kconfig
menu "malgrind agent"

    config MALGRIND_RATE_HZ
        int "Samples per second per core"
        range 10 5000
        default 997
        help
            How often the agent samples where the CPU is, per core. The default is prime so that it never aliases with the
            RTOS tick. The cost is about 1.5 % of one core per 1000 Hz. malgrind sets this from its run settings; changing it
            changes the sdkconfig, which makes ESP-IDF rebuild the agent.

    config MALGRIND_START_SAMPLING
        bool "Start sampling immediately on boot"
        default y
        help
            When enabled (default), the agent starts sampling immediately on boot for compatibility with older hosts
            (<= 0.4) that expect sample frames right away without sending a START command. Disable this to boot in
            sleep mode (timers stopped, ~0 CPU overhead, emitting a HELLO beacon every 1000 ms) until a v2 host sends
            a START command.

endmenu
```
